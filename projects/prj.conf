## CMakeLists.txt
```
# ARBATOS Zephyr 4.4 application entry.
cmake_minimum_required(VERSION 3.20.0)

get_filename_component(ARBATOS_ROOT "${CMAKE_CURRENT_SOURCE_DIR}/.." ABSOLUTE)
set(ARBATOS_ROBOT "HERO-M" CACHE STRING "Robotconfig target name")
file(GLOB_RECURSE ARBATOS_ROBOT_CONFIG_INPUTS CONFIGURE_DEPENDS
    "${ARBATOS_ROOT}/Robotconfig/*/RobotConfig.toml"
    "${ARBATOS_ROOT}/boards/*/PortCatalog.toml"
    "${ARBATOS_ROOT}/shared/controllers/*/Controller.toml")
set_property(DIRECTORY APPEND PROPERTY CMAKE_CONFIGURE_DEPENDS
    "${ARBATOS_ROOT}/tools/config/RobotConfigGen.py"
    "${ARBATOS_ROOT}/tools/config/SourcePolicy.py"
    "${ARBATOS_ROOT}/shared/application/robot/RobotTaskCatalog.def"
    ${ARBATOS_ROBOT_CONFIG_INPUTS})

# 车型资料只在 Robotconfig/<车型>/RobotConfig.toml 中维护。这里在
# find_package(Zephyr) 前生成配置，确保 BOARD、Kconfig 片段和 overlay 都来自同一份声明。
if(NOT DEFINED Python3_EXECUTABLE AND DEFINED WEST_PYTHON)
    set(Python3_EXECUTABLE "${WEST_PYTHON}" CACHE FILEPATH "Python used by west")
endif()
find_package(Python3 3.12 REQUIRED COMPONENTS Interpreter)
set(ARBATOS_TARGET_GENERATED_DIR "${CMAKE_BINARY_DIR}/generated/robotconfig")
execute_process(
    COMMAND "${Python3_EXECUTABLE}" -X utf8 "${ARBATOS_ROOT}/tools/config/RobotConfigGen.py"
        generate --target "${ARBATOS_ROBOT}" --out "${ARBATOS_TARGET_GENERATED_DIR}"
    WORKING_DIRECTORY "${ARBATOS_ROOT}"
    RESULT_VARIABLE ARBATOS_TARGET_GENERATE_RESULT
    OUTPUT_VARIABLE ARBATOS_TARGET_GENERATE_OUTPUT
    ERROR_VARIABLE ARBATOS_TARGET_GENERATE_ERROR
)
if(NOT ARBATOS_TARGET_GENERATE_RESULT EQUAL 0)
    message(FATAL_ERROR "Cannot generate robot configuration for ${ARBATOS_ROBOT}: ${ARBATOS_TARGET_GENERATE_ERROR}${ARBATOS_TARGET_GENERATE_OUTPUT}")
endif()
include("${ARBATOS_TARGET_GENERATED_DIR}/RobotTarget.cmake")
if(NOT DEFINED ARBATOS_BOARD OR "${ARBATOS_BOARD}" STREQUAL "")
    message(FATAL_ERROR "RobotTarget.cmake did not provide ARBATOS_BOARD")
endif()
if(NOT DEFINED ARBATOS_TARGET_HAS_SDLOG OR NOT DEFINED ARBATOS_TARGET_WATCH_FULL)
    message(FATAL_ERROR "RobotTarget.cmake is missing diagnostic selection; regenerate the selected Robotconfig")
endif()
if(DEFINED BOARD AND NOT "${BOARD}" STREQUAL "${ARBATOS_BOARD}")
    message(FATAL_ERROR "BOARD=${BOARD} conflicts with ${ARBATOS_ROBOT} board ${ARBATOS_BOARD}")
endif()
set(BOARD "${ARBATOS_BOARD}" CACHE STRING "Zephyr board selected by ARBATOS_ROBOT" FORCE)
set(ARBATOS_TARGET_CONF "${ARBATOS_TARGET_GENERATED_DIR}/robot.conf")
set(ARBATOS_OLD_TARGET_CONF "${CMAKE_CURRENT_SOURCE_DIR}/${ARBATOS_ROBOT}/prj.conf")
# 生成的 robot.conf 永远排在前面。专用音乐、准备和只接收配置只能追加；
# 它们不能重新选择车型或替换正式车型的基础能力。
set(ARBATOS_EXTRA_CONF_FILES "")
if(DEFINED EXTRA_CONF_FILE)
    foreach(ARBATOS_CONF IN LISTS EXTRA_CONF_FILE)
        if("${ARBATOS_CONF}" STREQUAL "" OR "${ARBATOS_CONF}" STREQUAL "${ARBATOS_TARGET_CONF}")
            continue()
        endif()
        if("${ARBATOS_CONF}" STREQUAL "${ARBATOS_OLD_TARGET_CONF}")
            # 旧缓存只保留同车型路径的一次迁移兼容，不能再次叠加。
            continue()
        endif()
        get_filename_component(ARBATOS_CONF_ABSOLUTE "${ARBATOS_CONF}" ABSOLUTE
            BASE_DIR "${CMAKE_CURRENT_SOURCE_DIR}")
        if(NOT EXISTS "${ARBATOS_CONF_ABSOLUTE}")
            message(FATAL_ERROR "EXTRA_CONF_FILE references missing file: ${ARBATOS_CONF}")
        endif()
        file(STRINGS "${ARBATOS_CONF_ABSOLUTE}" ARBATOS_CONF_IDENTITY
            REGEX "^[ \t]*CONFIG_ARBATOS_(ROBOT_NAME|TARGET_[A-Z0-9_]+|LEGACY_SOURCES)=")
        if(ARBATOS_CONF_IDENTITY)
            message(FATAL_ERROR "Extra configuration ${ARBATOS_CONF} must not select or replace a robot identity")
        endif()
        list(APPEND ARBATOS_EXTRA_CONF_FILES "${ARBATOS_CONF_ABSOLUTE}")
    endforeach()
endif()
list(REMOVE_DUPLICATES ARBATOS_EXTRA_CONF_FILES)
if(NOT ARBATOS_TARGET_HAS_SDLOG)
    foreach(ARBATOS_CONF IN LISTS ARBATOS_EXTRA_CONF_FILES)
        file(STRINGS "${ARBATOS_CONF}" ARBATOS_DIAGNOSTIC_LOG_CONFIG
            REGEX "^[ \\t]*CONFIG_ARBATOS_(PREFLIGHT_ONLY|RECEIVE_ONLY|BENCH_TELEMETRY)=y")
        if(ARBATOS_DIAGNOSTIC_LOG_CONFIG)
            message(FATAL_ERROR "${ARBATOS_CONF} requires the SDLOG service in Robotconfig/${ARBATOS_ROBOT}/RobotConfig.toml; this diagnostic mode must not run with an empty logger")
        endif()
    endforeach()
endif()
set(EXTRA_CONF_FILE "${ARBATOS_TARGET_CONF};${ARBATOS_EXTRA_CONF_FILES}" CACHE STRING
    "Generated robot configuration followed by optional test fragments" FORCE)
if(ARBATOS_TARGET_OVERLAY)
    set(ARBATOS_OLD_TARGET_OVERLAY "${CMAKE_CURRENT_SOURCE_DIR}/${ARBATOS_ROBOT}/app.overlay")
    if(DEFINED DTC_OVERLAY_FILE AND NOT "${DTC_OVERLAY_FILE}" STREQUAL "" AND
       NOT "${DTC_OVERLAY_FILE}" STREQUAL "${ARBATOS_TARGET_OVERLAY}" AND
       NOT "${DTC_OVERLAY_FILE}" STREQUAL "${ARBATOS_OLD_TARGET_OVERLAY}")
        message(FATAL_ERROR "DTC_OVERLAY_FILE=${DTC_OVERLAY_FILE} conflicts with ${ARBATOS_ROBOT} overlay ${ARBATOS_TARGET_OVERLAY}")
    endif()
    set(DTC_OVERLAY_FILE "${ARBATOS_TARGET_OVERLAY}" CACHE FILEPATH "Robot device-tree overlay" FORCE)
elseif(DEFINED DTC_OVERLAY_FILE AND NOT "${DTC_OVERLAY_FILE}" STREQUAL "")
    message(FATAL_ERROR "DTC_OVERLAY_FILE is set but ${ARBATOS_ROBOT} has no declared overlay")
endif()

list(APPEND BOARD_ROOT ${ARBATOS_ROOT})
list(APPEND DTS_ROOT ${ARBATOS_ROOT}/boards)
find_package(Zephyr 4.4 REQUIRED HINTS $ENV{ZEPHYR_BASE})
project(arbatos)


include(${CMAKE_CURRENT_SOURCE_DIR}/cmake/ArbatosBuildInfo.cmake)
arbatos_add_build_info(app)

target_sources(app PRIVATE
    src/main.c
    src/ArbatosTarget.c
)
target_sources_ifdef(CONFIG_ARBATOS_LOG_RAM app PRIVATE ${ARBATOS_ROOT}/shared/zephyr/port/platform/ArbLogRam.c)

target_sources_ifdef(CONFIG_ARBATOS_LEGACY_SOURCES app PRIVATE
    src/ArbatosRuntime.c
    ${ARBATOS_ROOT}/shared/zephyr/compat/freertos/ArbFreeRtosCompat.c
    ${ARBATOS_ROOT}/shared/zephyr/port/common/BspCoreZephyr.c
    ${ARBATOS_ROOT}/shared/zephyr/port/algorithm/AhrsZephyr.c
    ${ARBATOS_ROOT}/shared/zephyr/port/algorithm/ArmMathZephyr.c
    ${ARBATOS_ROOT}/shared/zephyr/port/can/BspCanZephyr.c
    ${ARBATOS_ROOT}/shared/zephyr/port/can/BspCanFaultPort.c
    ${ARBATOS_ROOT}/shared/zephyr/port/uart/BspZephyrUart.c
    ${ARBATOS_ROOT}/shared/zephyr/port/uart/BspRs485FaultPort.c
    ${ARBATOS_ROOT}/shared/zephyr/port/sensors/BspImuPwm.c
    ${ARBATOS_ROOT}/shared/zephyr/port/sensors/ImuFusionTask.c
    ${ARBATOS_ROOT}/shared/zephyr/port/sensors/ImuAttitude.c
    ${ARBATOS_ROOT}/shared/zephyr/port/storage/BspZephyrDiskio.c
    ${ARBATOS_ROOT}/shared/zephyr/port/storage/BspZephyrSdSpiPort.c
    ${ARBATOS_ROOT}/shared/zephyr/port/platform/ArbatosPlatform.c
    ${ARBATOS_ROOT}/shared/zephyr/port/platform/BspFlash.c
    ${ARBATOS_ROOT}/shared/zephyr/port/platform/BspKey.c
    ${ARBATOS_ROOT}/shared/zephyr/port/platform/BspLed.c
    ${ARBATOS_ROOT}/shared/zephyr/port/platform/BspResetEvidence.c
    ${ARBATOS_ROOT}/shared/zephyr/port/platform/RobotFaultZephyr.c
    ${ARBATOS_ROOT}/shared/zephyr/port/platform/BspServoPwm.c
    ${ARBATOS_ROOT}/shared/zephyr/port/platform/BspShootTrig.c
    ${ARBATOS_ROOT}/shared/zephyr/port/platform/BspUsb.c
    ${ARBATOS_ROOT}/shared/zephyr/port/usb/BspZephyrUsbCdc.c
)

if(CONFIG_ARBATOS_LEGACY_SOURCES)
    # 两个异常单元仍有不受 FAULT_DUMP 控制的打印；仅它们禁用日志，
    # 避免可恢复判断完成前或未处理 IRQ 路径重入日志锁，不改 SDK 源码。
    set_property(SOURCE "${ZEPHYR_BASE}/arch/arm/core/cortex_m/fault.c"
        TARGET_DIRECTORY arch__arm__core__cortex_m APPEND PROPERTY COMPILE_OPTIONS
        "-include" "${ARBATOS_ROOT}/shared/zephyr/include/ArbFaultLogConfig.h")
    set_property(SOURCE "${ZEPHYR_BASE}/arch/arm/core/fatal.c"
        TARGET_DIRECTORY arch__arm__core APPEND PROPERTY COMPILE_OPTIONS
        "-include" "${ARBATOS_ROOT}/shared/zephyr/include/ArbFaultLogConfig.h")
    # 保存 Zephyr 清除故障标志前的快照；可恢复异常仍由内核原流程处理。
    zephyr_link_libraries(-Wl,--wrap=z_arm_fault -Wl,--wrap=z_fatal_error)
    zephyr_linker_sources(SECTIONS ${ARBATOS_ROOT}/shared/zephyr/linker/arbatos-legacy-ram.ld)

    if(CONFIG_BOARD_DM_MC02_H7)
        target_sources(app PRIVATE ${ARBATOS_ROOT}/shared/zephyr/port/platform/BspBuzzerM.c ${ARBATOS_ROOT}/shared/zephyr/port/platform/MBoardIo.c
            ${ARBATOS_ROOT}/shared/zephyr/port/platform/BspAdcM.c ${ARBATOS_ROOT}/shared/zephyr/port/sensors/ImuCalStore.c)
    elseif(CONFIG_BOARD_DJI_C_F407)
        target_sources(app PRIVATE ${ARBATOS_ROOT}/shared/zephyr/port/platform/BspBuzzerC.c ${ARBATOS_ROOT}/shared/zephyr/port/platform/BspAdc.c)
    else()
        target_sources(app PRIVATE ${ARBATOS_ROOT}/shared/zephyr/port/platform/BspBuzzer.c ${ARBATOS_ROOT}/shared/zephyr/port/platform/BspAdc.c)
    endif()
    target_sources_ifdef(CONFIG_ARBATOS_SUBBOARD_MUSIC app PRIVATE
        ${ARBATOS_ROOT}/shared/zephyr/port/subboard/SubBoardMusic.c)
    target_sources_ifdef(CONFIG_ARBATOS_PREFLIGHT_ONLY app PRIVATE
        ${ARBATOS_ROOT}/shared/zephyr/port/subboard/MPreflight.c)
    target_sources_ifdef(CONFIG_ARBATOS_RECEIVE_ONLY app PRIVATE
        ${ARBATOS_ROOT}/shared/zephyr/port/subboard/MReceiveCheck.c)
    target_sources_ifdef(CONFIG_ARBATOS_BENCH_TELEMETRY app PRIVATE
        ${ARBATOS_ROOT}/shared/zephyr/port/subboard/MBenchTelemetry.c)
    target_sources_ifdef(CONFIG_ARBATOS_MINI_BENCH app PRIVATE
        ${ARBATOS_ROOT}/shared/application/wheelleg/WheelLegBench.c)

    if(CONFIG_BOARD_DJI_A_F427)
        target_sources(app PRIVATE ${ARBATOS_ROOT}/shared/zephyr/port/sensors/Mpu6500.c
            ${ARBATOS_ROOT}/shared/zephyr/port/sensors/ImuCalStore.c)
    elseif(CONFIG_BOARD_DJI_C_F407)
        target_sources(app PRIVATE ${ARBATOS_ROOT}/shared/zephyr/port/sensors/BspBmi088Port.c ${ARBATOS_ROOT}/shared/zephyr/port/sensors/BspIst8310Port.c
            ${ARBATOS_ROOT}/shared/components/devices/Ist8310Driver.c
            ${ARBATOS_ROOT}/shared/zephyr/port/sensors/ImuCalStore.c)
    elseif(CONFIG_BOARD_DM_MC02_H7)
        target_sources(app PRIVATE ${ARBATOS_ROOT}/shared/zephyr/port/sensors/BspBmi088Port.c)
    else()
        message(FATAL_ERROR "Board sensor port is not configured")
    endif()

endif()

target_include_directories(app BEFORE PRIVATE
    ${ARBATOS_TARGET_GENERATED_DIR}
    ${ARBATOS_ROOT}/shared/zephyr/include
    ${ARBATOS_ROOT}/shared/zephyr/compat/cmsis
    ${ARBATOS_ROOT}/shared/zephyr/compat/freertos
    ${ARBATOS_ROOT}/shared/zephyr/compat/stm32
    ${ARBATOS_ROOT}/shared/zephyr/port/algorithm/include
    ${ARBATOS_ROOT}/shared/zephyr/port/can
    ${ARBATOS_ROOT}/shared/zephyr/port/uart
    ${ARBATOS_ROOT}/shared/zephyr/port/sensors
    ${ARBATOS_ROOT}/shared/zephyr/port/storage
    ${ARBATOS_ROOT}/shared/zephyr/port/platform
    ${ARBATOS_ROOT}/shared/zephyr/port/subboard
    ${ARBATOS_ROOT}/shared/zephyr/port/usb
)

# The existing Robotconfig and shared trees were written for STM32 HAL and
# FreeRTOS.  Keep their exact source locations in the build graph, but make
# reuse opt-in until the Zephyr port layer supplies every required interface.
include(${CMAKE_CURRENT_SOURCE_DIR}/cmake/ArbatosLegacy.cmake)
arbatos_add_legacy_sources(app)
```

## Kconfig
```
mainmenu "ARBATOS Zephyr firmware"

source "Kconfig.zephyr"

menu "ARBATOS robot application"

config ARBATOS_ROBOT_NAME
    string "Robotconfig target name"
    default "HERO-M"
    help
      This value is generated from Robotconfig/<target>/RobotConfig.toml.
      Do not select a target here: board, sources and target settings all
      come from that same declaration before Zephyr configuration starts.

# 兼容尚未迁移的板级功能；新车型不需要在这里加枚举项。
config ARBATOS_TARGET_HERO_M
    bool
    default y if ARBATOS_ROBOT_NAME = "HERO-M"

config ARBATOS_TARGET_SENTINEL_M
    bool
    default y if ARBATOS_ROBOT_NAME = "SENTINEL-M"

config ARBATOS_TARGET_MINIWHEELEG_M
    bool
    default y if ARBATOS_ROBOT_NAME = "MINIWHEELEG-M"

config ARBATOS_LEGACY_SOURCES
    bool "Compile selected robot's shared ARBATOS sources"
    default n
    help
      Adds the selected Robotconfig, shared application, algorithm and support
      source manifest through the Zephyr compatibility and board-driver layers.
      The symbol keeps its historical name so existing configurations still work.

config ARBATOS_BOOT_BANNER
    bool "Print target name at startup"
    default y

config ARBATOS_M_BOARD_IO
    bool
    default y if BOARD_DM_MC02_H7 && ARBATOS_LEGACY_SOURCES
    select ADC
    select CRC
    select FLASH
    select FLASH_MAP

config ARBATOS_A_IMU_CAL
    bool
    default y if (BOARD_DJI_A_F427 || BOARD_DJI_C_F407) && ARBATOS_LEGACY_SOURCES
    select CRC
    select FLASH
    select FLASH_MAP

config ARBATOS_LOG_RAM
    bool "Keep Zephyr messages in debugger-readable RAM"
    depends on LOG && !LOG_MODE_MINIMAL
    select LOG_OUTPUT
    default y
    help
      Supplies a log backend when no UART console is available. Old messages
      are overwritten without waiting for a connected debugger.

config ARBATOS_SUBBOARD_MUSIC
    bool "M subboard SD music and track buttons"
    depends on BOARD_DM_MC02_H7 && ARBATOS_LEGACY_SOURCES
    default y if ARBATOS_ROBOT_NAME = "HERO-M"
    help
      Play SD PCM music using the V2 subboard buttons PD14 and PD15.

config ARBATOS_MUSIC_ONLY
    bool "Start only the SD music service"
    depends on ARBATOS_SUBBOARD_MUSIC
    default n
    help
      Bench startup for validating the formal Zephyr storage and audio ports.
      Does not initialize CAN or start robot control, heater or servo tasks.

config ARBATOS_PREFLIGHT_ONLY
    bool "Run stationary M board checks without motor tasks"
    depends on BOARD_DM_MC02_H7 && ARBATOS_LEGACY_SOURCES
    depends on !ARBATOS_MUSIC_ONLY
    default n
    help
      Starts only IMU acquisition, its bounded heater and SD logging checks.
      CAN transmit, robot control and external servo tasks remain inactive.

config ARBATOS_RECEIVE_ONLY
    bool "M board receive checks with command transmission blocked"
    depends on ARBATOS_PREFLIGHT_ONLY
    depends on ARBATOS_ROBOT_NAME = "HERO-M" || ARBATOS_ROBOT_NAME = "MINIWHEELEG-M"
    default n
    help
      Receive CAN feedback and remote input alongside preflight IMU checks.
      CAN hardware acknowledges frames, but application CAN and UART sends
      are rejected. No motion task is started; diagnostics use debug RAM.

config ARBATOS_PREFLIGHT_AWAKE
    bool "Keep stationary checks awake for wireless SWD access"
    depends on ARBATOS_PREFLIGHT_ONLY
    select ARM_ON_ENTER_CPU_IDLE_HOOK
    default n
    help
      Avoids idle sleep on probes that lose access to a sleeping H723.
      Only available in the stationary check image, without motor tasks.

config ARBATOS_BENCH_TELEMETRY
    bool "Stream stationary IMU and receiver diagnostics"
    depends on BOARD_DM_MC02_H7 && ARBATOS_LEGACY_SOURCES && LOG_BACKEND_UART
    default n
    help
      Adds deferred UART logging for bench measurements without halting the
      IMU task. This does not disable motor outputs in the normal firmware.

config ARBATOS_MINI_BENCH
    bool "Measured small wheel-leg fixed-height bench bring-up"
    depends on ARBATOS_ROBOT_NAME = "MINIWHEELEG-M" && !ARBATOS_PREFLIGHT_ONLY
    select ARM_ON_ENTER_CPU_IDLE_HOOK
    select ARBATOS_BENCH_TELEMETRY
    default n
    help
      Uses the measured-model controller. Motor output starts locked and
      requires an explicit RAM arm request plus the normal remote controls.

config ARBATOS_FREERTOS_MAX_TASKS
    int "Maximum legacy task count"
    # C 板最多 16 个车型任务，另有默认诊断和音乐线程；预留额外兼容任务。
    default 24 if BOARD_DJI_C_F407 && ARBATOS_LEGACY_SOURCES
    default 32
    range 16 64
    help
      Fixed-capacity task and notification registry used while the existing
      application tasks move from FreeRTOS/CMSIS-RTOS to native Zephyr APIs.

config ARBATOS_THREAD_STACK_POOL_SIZE
    int "Static legacy thread stack pool size in bytes"
    # C 板车型和音乐文件线程均自带栈，备用池留给额外兼容线程。
    default 2048 if BOARD_DJI_C_F407 && ARBATOS_LEGACY_SOURCES
    default 8192
    range 2048 16384
    help
      Fallback pool used only when osThreadNew is called without a caller
      supplied stack.  ARBATOS runtime tasks keep their explicit static
      stacks in CPU-local CCM/DTCM memory.  This pool is boot-only monotonic:
      memory is never freed or allocated from the Zephyr heap.

config ARBATOS_CMSIS_MUTEX_COUNT
    int "Maximum legacy CMSIS mutex count"
    default 16
    range 4 32

config ARBATOS_LEGACY_HEAP_SIZE
    int "Bounded legacy application heap size in bytes"
    default 16384 if BOARD_DJI_C_F407 && ARBATOS_LEGACY_SOURCES
    default 32768 if ARBATOS_LEGACY_SOURCES
    default 8192
    range 4096 65536
    help
      Dedicated Zephyr heap used only by the existing heap_malloc and
      pvPortMalloc compatibility calls.  Control threads and driver rings use
      static storage and do not consume this heap.

config APP_LINK_WITH_ARBATOS_PORT
    bool
    default y
    help
      Lets applications using this directory as ZEPHYR_EXTRA_MODULES inherit
      the public ARBATOS migration headers from the arbatos_port interface.

endmenu
```

## prj.conf
```kconfig
CONFIG_MAIN_STACK_SIZE=2048
CONFIG_LOG=y
CONFIG_LOG_MODE_DEFERRED=y
CONFIG_LOG_DEFAULT_LEVEL=3
CONFIG_CONSOLE=n
CONFIG_UART_CONSOLE=n
CONFIG_LOG_BACKEND_UART=n
CONFIG_ASSERT=y
CONFIG_ASSERT_VERBOSE=n
CONFIG_EXTRA_EXCEPTION_INFO=y
CONFIG_RUNTIME_NMI=y
CONFIG_FAULT_DUMP=0
CONFIG_EXCEPTION_DEBUG=n
CONFIG_EXCEPTION_STACK_TRACE=n
CONFIG_FPU=y
CONFIG_FPU_SHARING=y
CONFIG_THREAD_NAME=y
CONFIG_THREAD_STACK_INFO=y
CONFIG_THREAD_MONITOR=y
CONFIG_THREAD_RUNTIME_STATS=y
CONFIG_INIT_STACKS=y
CONFIG_NUM_PREEMPT_PRIORITIES=16
CONFIG_SYS_CLOCK_TICKS_PER_SEC=1000
CONFIG_SYSTEM_WORKQUEUE_STACK_SIZE=2048
CONFIG_HEAP_MEM_POOL_SIZE=4096
CONFIG_HWINFO=y
CONFIG_SERIAL=y
CONFIG_UART_INTERRUPT_DRIVEN=y
CONFIG_UART_LINE_CTRL=y
CONFIG_USB_DEVICE_STACK_NEXT=y
CONFIG_USBD_CDC_ACM_CLASS=y
CONFIG_CDC_ACM_SERIAL_INITIALIZE_AT_BOOT=n
CONFIG_CAN=y
CONFIG_CAN_DEFAULT_BITRATE=1000000
CONFIG_SPI=y
CONFIG_I2C=y
CONFIG_PWM=y
CONFIG_ADC=y
CONFIG_DMA=y
```

## src/ArbatosRuntime.c
```c
/*
 * SPDX-FileCopyrightText: 2026 陈轩 <2811158416@qq.com>
 * SPDX-License-Identifier: Apache-2.0
 */

#include <stdint.h>

#include <zephyr/devicetree.h>
#include <zephyr/kernel.h>
#include <zephyr/linker/section_tags.h>

#include "FreeRTOS.h"
#include "cmsis_os2.h"

#include "ArbatosRuntime.h"
#include "AppTaskBootstrap.h"
#include "BspBuzzer.h"
#include "BspUsb.h"
#include "ManualInput.h"
#include "RobotConfig.h"
#include "RobotControlRegistry.h"
#include "RobotTaskBuildConfig.h"
#include "RobotTargetTaskHeaders.h"
#include "Watch.h"
#if defined(CONFIG_ARBATOS_SUBBOARD_MUSIC)
#include "SubBoardMusic.h"
#endif

#ifndef ROBOT_WATCH_UPDATE_PERIOD_MS
#define ROBOT_WATCH_UPDATE_PERIOD_MS 1000u
#endif

#if DT_HAS_CHOSEN(zephyr_dtcm)
#define ARB_RUNTIME_STACK_SECTION __dtcm_bss_section
#else
#define ARB_RUNTIME_STACK_SECTION
#endif

#define ARB_STATIC_THREAD(thread_id, prio, stack_words)                                  \
    static struct z_thread_stack_element thread_id##_stack[                              \
        K_KERNEL_STACK_LEN((stack_words) * sizeof(StackType_t))]                         \
        __aligned(Z_KERNEL_STACK_OBJ_ALIGN) ARB_RUNTIME_STACK_SECTION;                    \
    static StaticTask_t thread_id##_control_block;                                       \
    static const osThreadAttr_t thread_id##_attr = {                                     \
        .name = #thread_id,                                                              \
        .priority = (prio),                                                              \
        .stack_mem = thread_id##_stack,                                                  \
        .stack_size = sizeof(thread_id##_stack),                                         \
        .cb_mem = &thread_id##_control_block,                                            \
        .cb_size = sizeof(thread_id##_control_block),                                    \
    }

#define ARB_THREAD_CREATE(thread_id, entry) \
    osThreadNew((osThreadFunc_t)(entry), NULL, &thread_id##_attr)

#if ROBOT_WATCH_FULL_ENABLED
static osThreadId_t ArbDefaultTaskHandle;
ARB_STATIC_THREAD(defaultTask, osPriorityNormal, ROBOT_RUNTIME_DEFAULT_STACK_WORDS);
#endif

#define ROBOT_RUNTIME_TASK(symbol, entry, threadName, priority, stackWords) \
    static osThreadId_t ArbTaskHandle_##symbol;                          \
    ARB_STATIC_THREAD(threadName, priority, stackWords);
#include "RobotTargetTasks.inc"
#undef ROBOT_RUNTIME_TASK

#if ROBOT_WATCH_FULL_ENABLED
static void ArbDefaultTask(void *argument)
{
    (void)argument;

    WatchInit();
    WatchDiagSetBootStage(WATCH_BOOT_STAGE_DEFAULT_TASK_START);
    WatchDiagSetBootStage(WATCH_BOOT_STAGE_RUN);

    for (;;)
    {
        WatchTaskBeat(WATCH_TASK_DEFAULT);
        WatchUpdate();
        (void)osDelay(ROBOT_WATCH_UPDATE_PERIOD_MS);
    }
}
#endif

#define ROBOT_RUNTIME_TASK(symbol, entry, threadName, priority, stackWords) \
    static osThreadId_t ArbCreateTask_##symbol(void)                        \
    {                                                                        \
        return ARB_THREAD_CREATE(threadName, entry);                         \
    }
#include "RobotTargetTasks.inc"
#undef ROBOT_RUNTIME_TASK

static uint8_t ArbCreateModuleTasks(void)
{
    const AppTaskModuleDesc moduleTasks[] = {
#define ROBOT_RUNTIME_TASK(symbol, entry, threadName, priority, stackWords) \
        APP_TASK_MODULE_DESC(ROBOT_TASK_MODULE_##symbol, &ArbTaskHandle_##symbol, ArbCreateTask_##symbol),
#include "RobotTargetTasks.inc"
#undef ROBOT_RUNTIME_TASK
        {ROBOT_TASK_MODULE_NONE, NULL, NULL, NULL},
    };

    return AppCreateEnabledModuleTasks(moduleTasks,
                                       (uint32_t)(sizeof(moduleTasks) / sizeof(moduleTasks[0])));
}

ArbatosRuntimeStatus ArbatosRuntimeStart(void)
{
    static uint8_t attempted;
    static ArbatosRuntimeStatus result = ARBATOS_RUNTIME_OK;

    if (attempted != 0u)
    {
        return (result == ARBATOS_RUNTIME_OK) ? ARBATOS_RUNTIME_ALREADY_STARTED : result;
    }
    attempted = 1u;

#if defined(CONFIG_ARBATOS_PREFLIGHT_ONLY)
    /* 静态准备只启动采样与记录，不创建任何电机或外接舵机任务。 */
    extern int MPreflightStart(void);
    if (RobotControlBootstrapProfileDefaults() == 0u) {
        result = ARBATOS_RUNTIME_CONTROL_CONFIG_FAILED;
        return result;
    }
    ManualInputInit();
    if (MPreflightStart() != 0) {
        result = ARBATOS_RUNTIME_MODULE_TASK_FAILED;
    }
    return result;
#endif

#if defined(CONFIG_ARBATOS_MUSIC_ONLY)
    /* HERO-M 运动映射尚待实车核对；音乐验证不初始化总线和控制输出。 */
    extern int BspBuzzerPlatformInit(void);
    if (BspBuzzerPlatformInit() != 0) {
        result = ARBATOS_RUNTIME_PLATFORM_INIT_FAILED;
        return result;
    }
    BuzzerSetEnable(1u);
    if (SubBoardMusicStart() != 0) {
        result = ARBATOS_RUNTIME_MODULE_TASK_FAILED;
    }
    return result;
#endif

    if (ArbatosPlatformInit() != 0)
    {
        result = ARBATOS_RUNTIME_PLATFORM_INIT_FAILED;
        return result;
    }

    if (RobotControlBootstrapProfileDefaults() == 0u) {
        result = ARBATOS_RUNTIME_CONTROL_CONFIG_FAILED;
        return result;
    }
    ManualInputInit();
    BuzzerSetEnable(1u);

#if ROBOT_TASK_BUILD_HOST_LINK || ROBOT_TASK_BUILD_IMU
    /* HostLink/VisionLink uses USB CDC even when StartupServiceTask is absent. */
    BspUsbDeviceInit();
#endif

#if ROBOT_WATCH_FULL_ENABLED
    ArbDefaultTaskHandle = ARB_THREAD_CREATE(defaultTask, ArbDefaultTask);
    if (ArbDefaultTaskHandle == NULL)
    {
        result = ARBATOS_RUNTIME_DEFAULT_TASK_FAILED;
        return result;
    }
#else
    /* 轻量诊断没有周期复制工作，不为它单独预留线程和栈。 */
    WatchInit();
    WatchDiagSetBootStage(WATCH_BOOT_STAGE_DEFAULT_TASK_START);
#endif
    if (ArbCreateModuleTasks() != 0u)
    {
        result = ARBATOS_RUNTIME_MODULE_TASK_FAILED;
        return result;
    }

#if defined(CONFIG_ARBATOS_SUBBOARD_MUSIC)
    if (SubBoardMusicStart() != 0) {
        result = ARBATOS_RUNTIME_MODULE_TASK_FAILED;
    }
#endif

#if !ROBOT_WATCH_FULL_ENABLED
    if (result == ARBATOS_RUNTIME_OK)
    {
        WatchDiagSetBootStage(WATCH_BOOT_STAGE_RUN);
    }
#endif

    return result;
}

const char *ArbatosRuntimeStatusName(ArbatosRuntimeStatus status)
{
    switch (status)
    {
        case ARBATOS_RUNTIME_OK:
            return "ok";
        case ARBATOS_RUNTIME_ALREADY_STARTED:
            return "already-started";
        case ARBATOS_RUNTIME_PLATFORM_INIT_FAILED:
            return "platform-init-failed";
        case ARBATOS_RUNTIME_DEFAULT_TASK_FAILED:
            return "default-task-failed";
        case ARBATOS_RUNTIME_MODULE_TASK_FAILED:
            return "module-task-failed";
        case ARBATOS_RUNTIME_CONTROL_CONFIG_FAILED:
            return "control-config-failed";
        default:
            return "unknown";
    }
}
```

## src/ArbatosTarget.c
```c
/*
 * SPDX-FileCopyrightText: 2026 陈轩 <2811158416@qq.com>
 * SPDX-License-Identifier: Apache-2.0
 */

#include <zephyr/logging/log.h>

#include "ArbatosTarget.h"

#if CONFIG_ARBATOS_LEGACY_SOURCES
#include "ArbatosRuntime.h"
#endif

LOG_MODULE_DECLARE(arbatos);

const char *ArbatosTargetName(void)
{
    return CONFIG_ARBATOS_ROBOT_NAME;
}

void ArbatosTargetStart(void)
{
#if CONFIG_ARBATOS_LEGACY_SOURCES
    ArbatosRuntimeStatus status = ArbatosRuntimeStart();

    if ((status != ARBATOS_RUNTIME_OK) &&
        (status != ARBATOS_RUNTIME_ALREADY_STARTED))
    {
        LOG_ERR("runtime start failed: %s", ArbatosRuntimeStatusName(status));
    }
#else
    LOG_INF("board smoke-test build; ARBATOS runtime is disabled");
#endif
}
```
