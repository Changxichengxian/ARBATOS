## boards/DjiAF427/zephyr/dji_a_f427_defconfig
```kconfig
# SPDX-License-Identifier: Apache-2.0

CONFIG_ARM_MPU=y
CONFIG_HW_STACK_PROTECTION=y
CONFIG_SERIAL=y
CONFIG_CONSOLE=n
CONFIG_UART_CONSOLE=n
CONFIG_GPIO=y
```

## boards/DmMc02H7/zephyr/board.yml
```yaml
board:
  name: dm_mc02_h7
  full_name: Damiao MC02 STM32H723
  vendor: arbatos
  socs:
    - name: stm32h723xx
```

## boards/dts/bindings/arbatos,platform.yaml
```yaml
description: ARBATOS board platform resources
compatible: "arbatos,platform"
properties:
  key-gpios: {type: phandle-array}
  hardware-version-gpios: {type: phandle-array}
  led0-gpios: {type: phandle-array}
  rgb-pwms:
    type: phandle-array
    specifier-space: pwm
  buzzer-pwms:
    type: phandle-array
    specifier-space: pwm
  shoot-trig-gpios: {type: phandle-array}
  servo-pwms:
    type: phandle-array
    specifier-space: pwm
```

## boards/dts/bindings/arbatos,sd-spi.yaml
```yaml
description: ARBATOS SD card using the repository SPI protocol layer

compatible: "arbatos,sd-spi"

include: spi-device.yaml
```

## boards/dts/bindings/arbatos,sensors.yaml
```yaml
description: ARBATOS board sensor resources
compatible: "arbatos,sensors"

properties:
  bmi088-spi:
    type: phandle
  bmi088-accel-cs-gpios:
    type: phandle-array
  bmi088-gyro-cs-gpios:
    type: phandle-array
  bmi088-spi-hz:
    type: int
  ist8310-i2c:
    type: phandle
  ist8310-reset-gpios:
    type: phandle-array
  mpu6500-spi:
    type: phandle
  mpu6500-cs-gpios:
    type: phandle-array
  mpu6500-spi-hz:
    type: int
  imu-heater-pwms:
    type: phandle-array
    specifier-space: pwm
  imu-heater-period-cycles:
    type: int
```

## shared/zephyr/module/Kconfig
```kconfig
# SPDX-License-Identifier: Apache-2.0
config APP_LINK_WITH_ARBATOS_PORT
    bool "Use ARBATOS compatibility headers"
    default y
```

## tests/Boards/a-sd.conf
```kconfig
CONFIG_DISK_ACCESS=y
CONFIG_DISK_DRIVERS=y
CONFIG_DISK_DRIVER_SDMMC=y
CONFIG_SDMMC_STM32=y
```

## tests/Boards/prj.conf
```kconfig
CONFIG_CONSOLE=n
CONFIG_UART_CONSOLE=n
CONFIG_PRINTK=n
CONFIG_GPIO=y
CONFIG_SPI=y
CONFIG_PWM=y
CONFIG_I2C=y
CONFIG_CAN=y
CONFIG_MAIN_STACK_SIZE=1024
```

## zephyr/Kconfig
```kconfig
mainmenu "ARBATOS Zephyr firmware"

source "Kconfig.zephyr"

menu "ARBATOS robot application"

choice ARBATOS_TARGET
    prompt "Robot target"
    default ARBATOS_TARGET_HERO_C
    help
      Selects one existing Robotconfig/<target> directory.  A board is still
      selected separately with west build -b.

config ARBATOS_TARGET_HERO_C
    bool "HERO-C"

config ARBATOS_TARGET_HERO_M
    bool "HERO-M"

config ARBATOS_TARGET_INFANTRY_A
    bool "INFANTRY-A"

config ARBATOS_TARGET_SENTINEL_M
    bool "SENTINEL-M"

config ARBATOS_TARGET_CARRIER_A
    bool "CARRIER-A"

config ARBATOS_TARGET_MINIWHEELEG_M
    bool "MINIWHEELEG-M"

config ARBATOS_TARGET_MINIWHEELEG_C
    bool "MINIWHEELEG-C"

endchoice

config ARBATOS_LEGACY_SOURCES
    bool "Compile selected Keil target's reusable ARBATOS sources"
    default n
    help
      Adds the selected Keil target's explicit Robotconfig, shared application,
      algorithm and support source manifest.  Legacy CubeMX startup, FreeRTOS,
      STM32 HAL/BSP code and ARMCC libraries stay excluded.  Enable this only
      with the Zephyr compatibility and board-driver layers for the target.

config ARBATOS_BOOT_BANNER
    bool "Print target name at startup"
    default y

config ARBATOS_FREERTOS_MAX_TASKS
    int "Maximum legacy task count"
    default 32
    range 16 64
    help
      Fixed-capacity task and notification registry used while the existing
      application tasks move from FreeRTOS/CMSIS-RTOS to native Zephyr APIs.

config ARBATOS_THREAD_STACK_POOL_SIZE
    int "Static legacy thread stack pool size in bytes"
    default 8192
    range 4096 16384
    help
      Fallback pool used only when osThreadNew is called without a caller
      supplied stack.  ARBATOS runtime tasks keep their explicit static
      stacks in CPU-local CCM/DTCM memory.  This pool is boot-only monotonic:
      memory is never freed or allocated from the Zephyr heap.

config ARBATOS_CMSIS_MUTEX_COUNT
    int "Maximum legacy CMSIS mutex count"
    default 16
    range 4 32

config ARBATOS_LEGACY_HEAP_SIZE
    int "Bounded legacy application heap size in bytes"
    default 32768 if ARBATOS_TARGET_HERO_M || ARBATOS_TARGET_SENTINEL_M || ARBATOS_TARGET_MINIWHEELEG_M
    default 8192
    range 4096 65536
    help
      Dedicated Zephyr heap used only by the existing heap_malloc and
      pvPortMalloc compatibility calls.  Control threads and driver rings use
      static storage and do not consume this heap.

config APP_LINK_WITH_ARBATOS_PORT
    bool
    default y
    help
      Lets applications using this directory as ZEPHYR_EXTRA_MODULES inherit
      the public ARBATOS migration headers from the arbatos_port interface.

endmenu
```

## zephyr/boards/dji_a_f427/Kconfig.dji_a_f427
```kconfig
# SPDX-License-Identifier: Apache-2.0

config BOARD_DJI_A_F427
	select SOC_STM32F427XX
```

## zephyr/boards/dji_a_f427/board.yml
```yaml
board:
  name: dji_a_f427
  full_name: DJI A Board STM32F427
  vendor: arbatos
  socs:
    - name: stm32f427xx
```

## zephyr/boards/dji_c_f407/board.yml
```yaml
board:
  name: dji_c_f407
  full_name: DJI C Board STM32F407
  vendor: arbatos
  socs:
    - name: stm32f407xx
```

## zephyr/boards/dm_mc02_h7/Kconfig.dm_mc02_h7
```kconfig
# SPDX-License-Identifier: Apache-2.0

config BOARD_DM_MC02_H7
	select SOC_STM32H723XX
```

## zephyr/dts/bindings/arbatos,platform.yaml
```yaml
description: ARBATOS board platform resources
compatible: "arbatos,platform"
properties:
  key-gpios: {type: phandle-array}
  led0-gpios: {type: phandle-array}
  buzzer-pwms:
    type: phandle-array
    specifier-space: pwm
  shoot-trig-gpios: {type: phandle-array}
```

## zephyr/west.yml
```yaml
manifest:
  version: "1.2"

  self:
    path: arbatos

  projects:
    - name: zephyr
      url: https://github.com/zephyrproject-rtos/zephyr
      revision: v4.4.0
      import: true
```
